## config/west.yml
```yaml
manifest:
  remotes:
    - name: zmkfirmware
      url-base: https://github.com/zmkfirmware
    - name: m165437
      url-base: https://github.com/M165437
    - name: nguyendown
      url-base: https://github.com/nguyendown 
  projects:
    - name: zmk
      remote: zmkfirmware
      revision: main
      import: app/west.yml
    - name: nice-view-gem
      remote: m165437
      revision: main
    - name: zmk-behavior-non-overlap
      remote: nguyendown
      revision: main
  self:
    path: config
```
